#pragma once
#include <Arduino.h>

// NEUES Startbild: schwarz/weisses Radio-Motiv aus webradioUnbenannt(1).png.
// 128x64 OLED-Bitmap fuer SSD1306 / SSD1309.
// Diese Datei ist absichtlich neu benannt, damit kein altes Bild aus Cache/Sketch-Ordner erwischt wird.
#define STARTUP_IMAGE_WIDTH 128
#define STARTUP_IMAGE_HEIGHT 64

const uint8_t startupImageBitmap[] PROGMEM = {
  0x00, 0x00, 0x00, 0x7F, 0xF8, 0x00, 0x00, 0x00, 0x00, 0x00, 0x7F, 0xF0, 0x3F, 0xF8, 0x00, 0x00,
  0x00, 0x00, 0x00, 0xFF, 0xF0, 0x00, 0x00, 0x00, 0x00, 0x00, 0x7F, 0xF8, 0x7F, 0xF8, 0x00, 0x00,
  0x00, 0x00, 0x00, 0xC1, 0xF0, 0x00, 0x00, 0x00, 0x00, 0x00, 0xE1, 0xF8, 0x71, 0xF8, 0x00, 0x00,
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  0x00, 0x01, 0xFF, 0xFF, 0xFF, 0xFF, 0xFF, 0xFF, 0xFF, 0xFF, 0xFF, 0xFF, 0xFF, 0xFF, 0x00, 0x00,
};

#define STARTUP_IMAGE_BOOT_STAGES 8
#define STARTUP_IMAGE_SCALE_START 100
#define STARTUP_IMAGE_SCALE_STEP 10
#define STARTUP_IMAGE_SCALE_PRE_MUSIC 20
#define STARTUP_IMAGE_SCALE_FINAL 10

static inline bool startupImageGetPixel(int16_t x, int16_t y) {
  if (x < 0 || x >= STARTUP_IMAGE_WIDTH || y < 0 || y >= STARTUP_IMAGE_HEIGHT) return false;
  uint16_t byteIndex = (y * (STARTUP_IMAGE_WIDTH / 8)) + (x / 8);
  uint8_t bitMask = 0x80 >> (x & 7);
  return (pgm_read_byte(&startupImageBitmap[byteIndex]) & bitMask) != 0;
}

static inline uint8_t startupImageScaleForStage(uint8_t stage) {
  if (stage > STARTUP_IMAGE_BOOT_STAGES) stage = STARTUP_IMAGE_BOOT_STAGES;
  uint8_t scale = STARTUP_IMAGE_SCALE_START - (stage * STARTUP_IMAGE_SCALE_STEP);
  if (scale < STARTUP_IMAGE_SCALE_PRE_MUSIC) scale = STARTUP_IMAGE_SCALE_PRE_MUSIC;
  return scale;
}

template <typename DisplayT>
static inline void drawStartupImageZoom(DisplayT &display, uint8_t scalePercent) {
  display.clearDisplay();
  const int16_t srcCx = STARTUP_IMAGE_WIDTH / 2;
  const int16_t srcCy = STARTUP_IMAGE_HEIGHT / 2;
  const int16_t dstCx = STARTUP_IMAGE_WIDTH / 2;
  const int16_t dstCy = STARTUP_IMAGE_HEIGHT / 2;
  for (int16_t y = 0; y < STARTUP_IMAGE_HEIGHT; y++) {
    int16_t sy = srcCy + ((int32_t)(y - dstCy) * 100L) / scalePercent;
    if (sy < 0 || sy >= STARTUP_IMAGE_HEIGHT) continue;
    for (int16_t x = 0; x < STARTUP_IMAGE_WIDTH; x++) {
      int16_t sx = srcCx + ((int32_t)(x - dstCx) * 100L) / scalePercent;
      if (startupImageGetPixel(sx, sy)) display.drawPixel(x, y, SSD1306_WHITE);
    }
  }
  display.display();
}

template <typename DisplayT>
static inline void drawStartupImageBootStage(DisplayT &display, uint8_t stage) {
  drawStartupImageZoom(display, startupImageScaleForStage(stage));
}